## CMakeLists.txt
```
cmake_minimum_required(VERSION 3.20.0)
find_package(Zephyr REQUIRED)
project(boot_profiling)

target_sources(app PRIVATE src/main.c src/boot_timing.c)
```

## prj.conf
```kconfig
CONFIG_EXTRA_EXCEPTION_INFO=y
CONFIG_BOOT_BANNER=n
```

## boards/nucleo_f446re.overlay
```dts
&usart2 {
	current-speed = <921600>;
};
```

## src/main.c
```c
#include <stdint.h>
#include <zephyr/kernel.h>

extern uint32_t boot_t[6];
enum { T_EARLY, T_PRE1, T_PRE2, T_POST, T_APP, T_MAIN };

#define CPU_HZ CONFIG_SYS_CLOCK_HW_CYCLES_PER_SEC

/* 사이클 → 마이크로초 */
static uint32_t to_us(uint32_t cyc) {
  return (uint32_t)((uint64_t)cyc * 1000000U / CPU_HZ);
}

static void report(const char *name, uint32_t from, uint32_t to) {
  uint32_t d = to - from;
  printk("%-14s %8u cyc  %8u us\n", name, d, to_us(d));
}

int main(void) {
  boot_t[T_MAIN] = (*(volatile uint32_t *)0xE0001004);

  printk("\n===== boot timing (CPU %u Hz) =====\n", CPU_HZ);
  report("EARLY", boot_t[T_EARLY], boot_t[T_PRE1]);
  report("PRE_KERNEL_1", boot_t[T_PRE1], boot_t[T_PRE2]);
  report("PRE_KERNEL_2", boot_t[T_PRE2], boot_t[T_POST]);
  report("POST_KERNEL", boot_t[T_POST], boot_t[T_APP]);
  report("APPLICATION", boot_t[T_APP], boot_t[T_MAIN]);
  printk("----------------------------------\n");
  report("total", boot_t[T_EARLY], boot_t[T_MAIN]);
  printk("==================================\n");

  return 0;
}
```

## src/boot_timing.c
```c
/*
 * 부팅 구간별 소요 시간 측정
 *
 * Zephyr 트리를 수정하지 않고 SYS_INIT 으로 각 초기화 레벨에
 * 우선순위 0(그 레벨에서 가장 먼저)으로 마커를 등록해 시각을 기록한다.
 * 계측은 Cortex-M4 내장 DWT 사이클 카운터를 사용한다.
 */

#include <stdint.h>
#include <zephyr/init.h>
#include <zephyr/kernel.h>

/* ARMv7-M 디버그 블록 레지스터 */
#define DEMCR (*(volatile uint32_t *)0xE000EDFC) /* 디버그 예외/모니터 제어 */
#define DWT_CTRL (*(volatile uint32_t *)0xE0001000)   /* DWT 제어 */
#define DWT_CYCCNT (*(volatile uint32_t *)0xE0001004) /* 사이클 카운터 */

#define DEMCR_TRCENA (1U << 24)  /* 트레이스 블록 전체 활성화 */
#define DWT_CTRL_CYCEN (1U << 0) /* 사이클 카운터 활성화 */

/* 각 구간 진입 시각 (사이클) */
uint32_t boot_t[6];

enum { T_EARLY, T_PRE1, T_PRE2, T_POST, T_APP, T_MAIN };

static void dwt_start(void) {
  DEMCR |= DEMCR_TRCENA;      /* 먼저 트레이스 블록을 켜야 DWT 접근 가능 */
  DWT_CYCCNT = 0;             /* 카운터 0으로 */
  DWT_CTRL |= DWT_CTRL_CYCEN; /* 카운트 시작 */
}

static int mark_early(void) {
  dwt_start(); /* 여기가 t=0 */
  boot_t[T_EARLY] = DWT_CYCCNT;
  return 0;
}

static int mark_pre1(void) {
  boot_t[T_PRE1] = DWT_CYCCNT;
  return 0;
}
static int mark_pre2(void) {
  boot_t[T_PRE2] = DWT_CYCCNT;
  return 0;
}
static int mark_post(void) {
  boot_t[T_POST] = DWT_CYCCNT;
  return 0;
}
static int mark_app(void) {
  boot_t[T_APP] = DWT_CYCCNT;
  return 0;
}

/* 각 레벨의 우선순위 0 = 그 레벨에서 가장 먼저 실행 */
SYS_INIT(mark_early, EARLY, 0);
SYS_INIT(mark_pre1, PRE_KERNEL_1, 0);
SYS_INIT(mark_pre2, PRE_KERNEL_2, 0);
SYS_INIT(mark_post, POST_KERNEL, 0);
SYS_INIT(mark_app, APPLICATION, 0);
```
